/*
 * Copyright (c) 2022 The ZMK Contributors
 *
 * SPDX-License-Identifier: MIT
 */

#include "waterfowl.dtsi"

/* --- Encoder 2 (oben rechts) --- */
encoder2: encoder_2 {
    compatible = "zmk,encoder";
    a-gpios = <&pro_micro 7 GPIO_ACTIVE_HIGH>;
    b-gpios = <&pro_micro 8 GPIO_ACTIVE_HIGH>;
    steps = <4>;
};

/* --- Encoder 3 (unten rechts) --- */
encoder3: encoder_3 {
    compatible = "zmk,encoder";
    a-gpios = <&pro_micro 9 GPIO_ACTIVE_HIGH>;
    b-gpios = <&pro_micro 10 GPIO_ACTIVE_HIGH>;
    steps = <4>;
};
